## arch/arm/mach-msm/lge/vee3/Kconfig
```kconfig
config MACH_MSM7X25A_V3
    depends on ARCH_MSM7X27A
    depends on !MSM_STACKED_MEMORY
    select MACH_LGE
    bool "MSM7x25A V3"
    help
        Support for the LG Electronics MSM7x25A V3.
```
